## package/cuboxgraphics/Config.in
```kconfig
config BR2_PACKAGE_CUBOXGRAPHICS
	bool "cuboxgraphics"
	help
	  proprietary libs
```

## package/cuboxxbmc/Config.in
```kconfig
config BR2_PACKAGE_CUBOXXBMC
	bool "cuboxxbmc"
	help
	  xbmc port to cubox

choice
	prompt "branch selection"
	default BR2_PACKAGE_CUBOXXBMC_GIMLI
	depends on BR2_PACKAGE_CUBOXXBMC

config BR2_PACKAGE_CUBOXXBMC_RABEEH
	bool "rabeeh branch (gstreamer & X needed, no vmeta accel)"

config BR2_PACKAGE_CUBOXXBMC_GIMLI
	bool "gimli branch (vmeta accel & X needed, no gstreamer)"

endchoice
```

## package/libplist/Config.in
```kconfig
config BR2_PACKAGE_LIBPLIST
	bool "libplist"
	help
	  A library to handle Apple Property List format whereas it's binary or XML.
```

## package/libshairport/Config.in
```kconfig
config BR2_PACKAGE_LIBSHAIRPORT
	bool "libshairport"
	help
	  Airtunes emulator!
```

## package/marvellgfx/Config.in
```kconfig
config BR2_PACKAGE_MARVELLGFX
	bool "marvel gfx"
	help
	  proprietary libs from marvell
```
